## gki_defconfig
```kconfig
# SDR 
CONFIG_USB_AIRSPY=m
CONFIG_USB_HACKRF=m
CONFIG_USB_MSI2500=m

# Bluetooth spoofing, spamming and attacks
CONFIG_BT_HCIVHCI=m

# Wireless network adapters 
CONFIG_MT7601U=m
CONFIG_RT2X00=m
CONFIG_RT2500USB=m
CONFIG_RT73USB=m
CONFIG_RT2800USB=m
CONFIG_RT2800USB_RT33XX=m
CONFIG_RT2800USB_RT35XX=m
CONFIG_RT2800USB_RT3573=m
CONFIG_RT2800USB_RT53XX=m
CONFIG_RT2800USB_RT55XX=m
CONFIG_RT2800USB_UNKNOWN=m
CONFIG_RTL8187=m
CONFIG_RTL_CARDS=m
CONFIG_RTL8192CU=m
CONFIG_RTL8XXXU_UNTESTED=m

# Enable QCACLD3.0 driver
# CONFIG_QCA_CLD_WLAN=y

CONFIG_DEFAULT_HOSTNAME="br0k3n"
```
